/*********************************************************************************************
* 文件：Weighing_devices.c
* 作者：chennian 2017.11.29
* 说明：电子秤驱动代码
* 修改：fuyou 2018.8.21 优化代码风格
* 注释：
*********************************************************************************************/

/*********************************************************************************************
* 头文件
*********************************************************************************************/
#include "weight.h"

/*********************************************************************************************
* 全局变量
*********************************************************************************************/
// 获取重量命令（1地址，2命令，3-4起始位，5-6数据长度，7-8(CRC-16/MODBUS））
static uint8_t GetweightCmd[8]   = {0x01, 0x03, 0x00, 0x00, 0x00, 0x01, 0x84, 0x0A}; //获取重量指令
static uint8_t calibration_0[8]  = {0x01, 0x06, 0x00, 0x12, 0x00, 0x01, 0xE8, 0x0F}; //0校准指令
static uint8_t calibration_V1[8] = {0x01, 0x06, 0x00, 0x12, 0x00, 0x02, 0xA8, 0x0E}; //快速标量校准内码复制指令
static uint8_t calibration_V[8]  = {0x01, 0x06, 0x00, 0x08, 0xff, 0xff, 0xff, 0xff}; //变量值设置指令
static uint8_t Rem_impur1[8]     = {0x01, 0x06, 0x00, 0x11, 0x00, 0x01, 0x18, 0x0f}; //变量值设置指令
static short weight = 0;                                                                // 缓存重量值
static uint8_t flag    = 0;                                     //写寄存标志

/*********************************************************************************************
* 本地函数原型
*********************************************************************************************/
// UART RS485相关接口函数

static void uart_485_write(uint8_t *pbuf, uint16_t len);        //RS485数据发送函数
static void node_uart_callback (uint8_t event);                 //节点串口通讯回调函数
static uint16_t calc_crc(uint8_t *pbuf, uint8_t len);           //循环冗余校验函数

/*********************************************************************************************
* 名称：wds_io_init()
* 功能：风速传感器IO口的初始化
* 参数：无
* 返回：无
* 修改：
* 注释：
*********************************************************************************************/
void weight_io_init(void)
{
    // 初始化传感器代码
    uart4_init(9600);
    uart4_set_input(node_uart_callback);
}

/*********************************************************************************************
* 名称：uart_485_write()
* 功能：写485通讯
* 参数：pbuf -- 输入参数，发送命令指针
*       len -- 输入参数,发送命令长度
* 返回：无
* 修改：
* 注释：
*********************************************************************************************/
static void uart_485_write(uint8_t *pbuf, uint16_t len)
{
    for(int i=0; i<(int)len; i++)
        uart4_putc(*(pbuf+i));
}

/*********************************************************************************************
* 名称：weight_update()
* 功能：更新一次称重
* 参数：无
* 返回：无
* 修改：
* 注释：
*********************************************************************************************/
void weight_update(void)
{
    if(flag == 1)
    {
        uart_485_write(calibration_V,sizeof(calibration_V));
        flag = 0;
    }
    else
    {
        uart_485_write(GetweightCmd, sizeof(GetweightCmd));       //称重传感器写入读取指令
    }
}


/*********************************************************************************************
* 名称：calibration()
* 功能：校准函数
* 参数：weight--校准重量
* 返回：无
* 修改：
* 注释：
*********************************************************************************************/
void calibration(int weight)
{
    if(weight==0)                                                 //0校准判断
    {
        uart_485_write(calibration_0,sizeof(calibration_0));          //校准指令
    }
    else
    {
        uart_485_write(calibration_V1,sizeof(calibration_V1));      //内码复制指令
        uint16_t crc = 0;                                             //crc存储
        uint16_t weight16 =(uint16_t)weight*100;

        calibration_V[4]=weight16>>8;
        calibration_V[5]=weight16;

        crc = calc_crc(calibration_V,6);
        calibration_V[6]=crc;
        calibration_V[7]=crc>>8;
        flag = 1;                                                   //标量值跟新标志位置1
    }
}

/*********************************************************************************************
* 名称：Rem_impur()
* 功能：去皮函数
* 参数：choose（choose=1，去皮操作；choose=0，取消去皮操作）
* 返回：无
* 修改：
* 注释：
*********************************************************************************************/

void Rem_impur(uint8_t choose)
{
    uint16_t crc = 0;
    Rem_impur1[5]=choose;
    crc = calc_crc(Rem_impur1,6);
    Rem_impur1[6]=crc;
    Rem_impur1[7]=crc>>8;
    uart_485_write(Rem_impur1,sizeof(Rem_impur1));

}
/*********************************************************************************************
* 名称：node_uart_callback()
* 功能：节点串口通讯回调函数
* 参数：port -- 输入参数，接收端口
*       event -- 输入参数，接收事件
* 返回：无
* 修改：
* 注释：
*********************************************************************************************/
static void node_uart_callback (uint8_t event)
{
#define RBUFSIZE 32
    (void)event;
    uint8_t  ch = event;
    static uint8_t szBuf[RBUFSIZE];
    static uint8_t  status = 0, len = 0;

    if(ch == 0x01)                                              //当检测到0x01
    {
        status = 1;                                               //进入状态一
    }
    else if(ch == 0x03 && status ==1)                           //当检测到0x03且此时的状态为1
    {
        status = 2;                                               //进入状态二
    }
    else if(ch == 0x02 && status ==2)                           //当检测到0x02且此时状态为2
    {
        status = 3;                                               //进入状态三
    }
    else if(status == 3)                                         //当进入状态三表示开始接收到有效数据
    {
        szBuf[len++] = ch;                                        //存储当前接收接收到的数据
        if(len == 2)                                               //当接收数据长度为2时
        {
            weight = (szBuf[0] << 8) | szBuf[1];                 //有效数据接收完毕处理数据
            len = 0;
            status = 0;
        }
    }
    else
    {
        len = 0;
        status = 0;
    }
}

/*********************************************************************************************
* 名称：get_weight()
* 功能：返回秤重值
* 参数：无
* 返回：weight--重量
* 修改：
* 注释：
*********************************************************************************************/
float get_weight(void)
{
    return weight*0.01;                                             //返回浓度信息
}


/*********************************************************************************************
* 名称：calc_crc()
* 功能：crc校验
* 参数：pbuf -- 输入参数，校验指针
*       len -- 输入参数，校验数组长度
* 返回：无
* 修改：
* 注释：
*********************************************************************************************/
static uint16_t calc_crc(uint8_t *pbuf, uint8_t len)
{
    uint16_t crc = 0xffff;
    uint8_t k, i;

    for (k = 0; k < len; k++)
    {
        crc = crc ^ pbuf[k];
        for(i = 0; i < 8; i++)
        {
            uint8_t tmp;
            tmp = crc&1;
            crc = crc>>1;
            crc &= 0x7fff;
            if (tmp == 1)
            {
                crc ^= 0xa001;
            }
            crc &= 0xffff;
        }
    }
    return crc;
}
