/*********************************************************************************************
* 文件：ad5993.c
* 作者：zonesion
* 说明：ad5993驱动程序
* 修改：fuyou 2018.8.21 优化代码风格
* 注释：
*********************************************************************************************/
/*********************************************************************************************
* 头文件
*********************************************************************************************/
#include "ad5993.h"
#include "delay.h"

/*********************************************************************************************
* 宏定义
*********************************************************************************************/
#define AD5993_ADDR 0x0D
#define MAIN_CLOCK      16000000				//16776000   		   
//IO方向设置
//Pc9输入模式
#define SDA_IN()  {GPIOC->MODER&=~(3<<(4*2));GPIOC->MODER|=0<<4*2;}
//Pc9输出模式
#define SDA_OUT() {GPIOC->MODER&=~(3<<(4*2));GPIOC->MODER|=1<<4*2;}
//IO操作函数
#define IIC_SCL    PCout(2) 					//SCL
#define IIC_SDA    PCout(4) 					//SDA	 
#define READ_SDA   PCin(4)  					//输入SDA 

/*********************************************************************************************
* 名称：AD5993_IIC_Init()
* 功能：模拟IIC总线io的配置
* 参数：无
* 返回：无
* 修改：
* 注释：
*********************************************************************************************/
void AD5993_IIC_Init(void)
{
    GPIO_InitTypeDef  GPIO_InitStructure;
    RCC_AHB1PeriphClockCmd(RCC_AHB1Periph_GPIOC, ENABLE);		//使能GPIOC时钟
    //GPIOB8,B9初始化设置
    GPIO_InitStructure.GPIO_Pin = GPIO_Pin_2 ;
    GPIO_InitStructure.GPIO_Mode = GPIO_Mode_OUT;			//普通输出模式
    GPIO_InitStructure.GPIO_OType = GPIO_OType_PP;		//推挽输出
    GPIO_InitStructure.GPIO_Speed = GPIO_Speed_2MHz;		//100MHz
    GPIO_Init(GPIOC, &GPIO_InitStructure);			//初始化
    GPIO_InitStructure.GPIO_Pin = GPIO_Pin_4 ;
    GPIO_Init(GPIOC, &GPIO_InitStructure);
    GPIO_InitStructure.GPIO_PuPd = GPIO_PuPd_UP;			//上拉
    IIC_SCL=1;
    IIC_SDA=1;
}

/*********************************************************************************************
* 名称：AD5993_IIC_Start()
* 功能：产生IIC起始信号
* 参数：无
* 返回：无
* 修改：
* 注释：
*********************************************************************************************/
void AD5993_IIC_Start(void)
{
    SDA_OUT();                                                    //sda线输出
    IIC_SDA=1;
    IIC_SCL=1;
    delay_us(4);
    IIC_SDA=0;                                                    //START:when CLK is high,DATA change form high to low
    delay_us(4);
    IIC_SCL=0;                                                    //钳住I2C总线，准备发送或接收数据
}

/*********************************************************************************************
* 名称：AD5993_IIC_Stop()
* 功能：产生IIC停止信号
* 参数：无
* 返回：无
* 修改：
* 注释：
*********************************************************************************************/
void AD5993_IIC_Stop(void)
{
    SDA_OUT();//sda线输出
    IIC_SCL=0;
    IIC_SDA=0;//STOP:when CLK is high DATA change form low to high
    delay_us(4);
    IIC_SCL=1;
    delay_us(2);
    IIC_SDA=1;//发送I2C总线结束信号
    delay_us(4);
}

/*********************************************************************************************
* 名称：AD5993_IIC_Wait_Ack()
* 功能：等待应答信号到来
* 参数：无
* 返回：1，接收应答失败  0，接收应答成功
* 修改：
* 注释：
*********************************************************************************************/
u8 AD5993_IIC_Wait_Ack(void)
{
    u8 ucErrTime=0;
    SDA_IN();                                                     //SDA设置为输入
    IIC_SDA=1;
    delay_us(1);
    IIC_SCL=1;
    delay_us(1);
    while(READ_SDA)
    {
        ucErrTime++;
        if(ucErrTime>250)
        {
            AD5993_IIC_Stop();
            return 1;
        }
    }
    IIC_SCL=0;                                                    //时钟输出0
    return 0;
}

/*********************************************************************************************
* 名称：AD5993_IIC_Ack()
* 功能：产生应答信号
* 参数：无
* 返回：无
* 修改：
* 注释：
*********************************************************************************************/
void AD5993_IIC_Ack(void)
{
    IIC_SCL=0;
    SDA_OUT();
    IIC_SDA=0;
    delay_us(2);
    IIC_SCL=1;
    delay_us(2);
    IIC_SCL=0;
}

/*********************************************************************************************
* 名称：AD5993_IIC_NAck()
* 功能：不产生应答信号
* 参数：无
* 返回：无
* 修改：
* 注释：
*********************************************************************************************/
void AD5993_IIC_NAck(void)
{
    IIC_SCL=0;
    SDA_OUT();
    IIC_SDA=1;
    delay_us(2);
    IIC_SCL=1;
    delay_us(2);
    IIC_SCL=0;
}

/*********************************************************************************************
* 名称：AD5993_IIC_Send_Byte()
* 功能：IIC发送一个字节
* 参数：无
* 返回：返回从机有无应答  1，有应答  0，无应答
* 修改：
* 注释：
*********************************************************************************************/
void AD5993_IIC_Send_Byte(u8 txd)
{
    u8 t;
    SDA_OUT();
    IIC_SCL=0;                                                    //拉低时钟开始数据传输
    for(t=0; t<8; t++)
    {
        IIC_SDA=(txd&0x80)>>7;
        txd<<=1;
        delay_us(2);                                                //对TEA5767这三个延时都是必须的
        IIC_SCL=1;
        delay_us(2);
        IIC_SCL=0;
        delay_us(2);
    }
}

/*********************************************************************************************
* 名称：AD5993_IIC_Read_Byte()
* 功能：读1个字节
* 参数：ack -- 应答信号
* 返回：ack=1时，发送ACK，ack=0，发送nACK
* 修改：
* 注释：
*********************************************************************************************/
u8 AD5993_IIC_Read_Byte(unsigned char ack)
{
    unsigned char i,receive=0;
    SDA_IN();                                                     //SDA设置为输入
    for(i=0; i<8; i++ )
    {
        IIC_SCL=0;
        delay_us(2);
        IIC_SCL=1;
        receive<<=1;
        if(READ_SDA)receive++;
        delay_us(1);
    }
    if (!ack)
        AD5993_IIC_NAck();                                          //发送nACK
    else
        AD5993_IIC_Ack();                                           //发送ACK
    return receive;
}

/*********************************************************************************************
* 名称：AD5993_IIC_Read()
* 功能：读数据
* 参数：addr -- 地址
*       r -- 发送数据
*       buf -- 数组名
*       len -- 数组长度
* 返回：i -- 发送数据长度
* 修改：
* 注释：
*********************************************************************************************/
int AD5993_IIC_Read(char addr, char r, char *buf, int len)
{
    int i;
    AD5993_IIC_Start();
    AD5993_IIC_Send_Byte(addr<<1);
    if (AD5993_IIC_Wait_Ack()) return -1;
    AD5993_IIC_Send_Byte(r);
    if (AD5993_IIC_Wait_Ack()) return -1;
    AD5993_IIC_Start();
    AD5993_IIC_Send_Byte((addr<<1)|1);
    if (AD5993_IIC_Wait_Ack()) return -1;
    for (i=0; i<len-1; i++)
    {
        buf[i] = AD5993_IIC_Read_Byte(1);
    }
    buf[i++] = AD5993_IIC_Read_Byte(0);
    AD5993_IIC_Stop();
    return i;
}

/*********************************************************************************************
* 名称：AD5993_IIC_Write()
* 功能：写数据
* 参数：addr -- 地址
*       r -- 发送数据
*       buf -- 数组名
*       len -- 数组长度
* 返回：i -- 发送数据长度
* 修改：
* 注释：
*********************************************************************************************/
int AD5993_IIC_Write(char addr, char r, char *buf, int len)
{
    int i;
    AD5993_IIC_Start();
    AD5993_IIC_Send_Byte(addr<<1);
    if (AD5993_IIC_Wait_Ack()) return -1;
    AD5993_IIC_Send_Byte(r);
    if (AD5993_IIC_Wait_Ack()) return -1;
    for (i=0; i<len; i++)
    {
        AD5993_IIC_Send_Byte(buf[i]);
        if (AD5993_IIC_Wait_Ack()) return -1;
    }
    AD5993_IIC_Stop();
    return i;
}

/*********************************************************************************************
* 名称：AD5993_Write_Reg()
* 功能：写数据接口函数
* 参数：r -- 发送数据
*       v -- 数组名
* 返回：i -- 发送数据长度
* 修改：
* 注释：
*********************************************************************************************/
int AD5993_Write_Reg(char r, char v)
{
    return AD5993_IIC_Write(AD5993_ADDR, r, &v, 1);
}

/*********************************************************************************************
* 名称：AD5993_Read_Reg()
* 功能：写数据接口函数
* 参数：r -- 发送数据
* 返回：v -- 数组名
* 修改：
* 注释：
*********************************************************************************************/
int AD5993_Read_Reg(char r)
{
    char v;
    int ret = AD5993_IIC_Read(AD5993_ADDR, r, &v, 1);
    if (ret == 1) return v;
    return -1;
}

/*********************************************************************************************
* 名称：AD5993_Init()
* 功能：ad5993初始化
* 参数：无
* 返回：无
* 修改：
* 注释：
*********************************************************************************************/
void AD5993_Init(void)
{
    int v1, v2, v;
    AD5993_IIC_Init();
    AD5993_Write_Reg(0x81, 0x10); //复位
    clock_delay_us(100);
    v1 = AD5993_Read_Reg(0x80);
    v2 = AD5993_Read_Reg(0x81);
    v  = (v1 << 8) | v2;
    if (v1<0 || v2<0)
    {
        printf("Error: can't find ic AD5993\r\n");
    }
    printf("AD5993 ctrl %04x\r\n", v);
}

/*********************************************************************************************
* 名称：AD5993_Start_F()
* 功能：设置起始频率
* 参数：无
* 返回：无
* 修改：
* 注释：
*********************************************************************************************/
void AD5993_Start_F(unsigned int f)
{
    //内部时钟 16.776MHz
    unsigned int v = (unsigned int)(f/(MAIN_CLOCK/4.0f)*(1<<27));
    AD5993_Write_Reg(0x82, (v>>16)&0xff);
    AD5993_Write_Reg(0x83, (v>>8)&0xff);
    AD5993_Write_Reg(0x84, (v>>0)&0xff);
}

/*********************************************************************************************
* 名称：AD5993_Add_F()
* 功能：设置增量频率
* 参数：无
* 返回：无
* 修改：
* 注释：
*********************************************************************************************/
void AD5993_Add_F(unsigned int f)
{
    //内部时钟 16.776MHz
    unsigned int v = (unsigned int)(f/(MAIN_CLOCK/4.0f)*(1<<27));
    //printf(" add f %08x\r\n", v);
    AD5993_Write_Reg(0x85, (v>>16)&0xff);
    AD5993_Write_Reg(0x86, (v>>8)&0xff);
    AD5993_Write_Reg(0x87, (v>>0)&0xff);
}

/*********************************************************************************************
* 名称：AD5993_Add_N()
* 功能：设置增量数
* 参数：无
* 返回：无
* 修改：
* 注释：
*********************************************************************************************/
void AD5993_Add_N(unsigned int v)
{
    AD5993_Write_Reg(0x88, (v>>8)&0xff);
    AD5993_Write_Reg(0x89, (v>>0)&0xff);
}

/*********************************************************************************************
* 名称：AD5993_Start_Delay_T()
* 功能：设置延时
* 参数：无
* 返回：无
* 修改：
* 注释：
*********************************************************************************************/
void AD5993_Start_Delay_T(unsigned int v)
{
    AD5993_Write_Reg(0x8a, (v>>8)&0xff);
    AD5993_Write_Reg(0x8b, (v>>0)&0xff);
}

/*********************************************************************************************
* 名称：AD5993_Scan()
* 功能：扫描
* 参数：无
* 返回：无
* 修改：
* 注释：
*********************************************************************************************/
int AD5993_Scan(short *buf)
{
    int r, v1, v2, v3, v4;
    int n = 0;
    AD5993_Write_Reg(0x80, 0xB0);                                 //进入待机模式
    clock_delay_us(100);
    AD5993_Write_Reg(0x80, 0x10);                                 //以起始频率初始化
    clock_delay_ms(1);
    AD5993_Write_Reg(0x80, 0x20);                                 //启动频率扫描
    clock_delay_us(10);
_r:
    do
    {
        r = AD5993_Read_Reg(0x8f);
        clock_delay_us(10);
        if (r < 0) return -1;
    }
    while ((r & 0x02) == 0);
    //读取实部和虚部
    v1 = AD5993_Read_Reg(0x94);
    v2 = AD5993_Read_Reg(0x95);
    v3 = AD5993_Read_Reg(0x96);
    v4 = AD5993_Read_Reg(0x97);
    if (v1 < 0 || v2 < 0 || v3 < 0 || v4 < 0) return -1;
    int real = (v1<<8) | v2;
    int v = (v3<<8) | v4;
    buf[2*n] = real;
    buf[2*n+1] = v;
    n += 1;
    if (r & 0x04)                                                 //扫描完成
    {
        AD5993_Write_Reg(0x80, 0xA0);                               //进入省电模式
        return n;
    }
    else
    {
        AD5993_Write_Reg(0x80, 0x30);                               //递增频率
        clock_delay_us(10);
        goto _r;
    }
}