#include <string.h>
#include "telecontrol.h"
#include "usart.h"

#define LEARN_CMD               0xF0                            // 学习模式        
#define EXIT_CMD                0xF2                            // 遥控模式        
#define LEARN_SUCCESS_RET       0x00                            // 学习成功
#define LEARN_ERROR_RET         0xFF                            // 学习失败

uint8_t currentMode = 0;                                        // 当前模式
uint8_t currentStatus = 0;                                      // 当前学习模式
uint8_t keyValue = 0;                                           // 当前按键值
uint8_t handleFlag = 0;                                         // 学习模式操作状态

/*********************************************************************************************
* 名称：uart2_set_input_call()
* 功能：设置串口2回调函数
* 参数：无
* 返回：无
* 修改：
* 注释：
*********************************************************************************************/
void uart2_set_input_call(int (*c)(char ch))
{
  uart2_set_input(c);
}

/*********************************************************************************************
* 名称：uart2_send_data()
* 功能：串口2发送数据
* 参数：buf-需要发送的数据/len-数据长度
* 返回：无
* 修改：
* 注释：
*********************************************************************************************/
void uart2_send_data(char* buf, unsigned int len)
{
  for(unsigned int i=0; i<len; i++)
    uart2_putc(buf[i]);
}

/*********************************************************************************************
* 名称：telecontrol_init()
* 功能：红外遥控初始化
* 参数：无
* 返回：无
* 修改：
* 注释：
*********************************************************************************************/
void telecontrol_init(void)
{
  uart2_init(9600);
  uart2_set_input_call(uart2_rec_handle);
}

/*********************************************************************************************
* 名称：set_currentMode()
* 功能：设置当前遥控模式
* 参数：mode-当前遥控模式
* 返回：无
* 修改：
* 注释：
*********************************************************************************************/
void set_currentMode(uint8_t mode)
{
  if(mode)
    uart2_putc(LEARN_CMD);
  else
    uart2_putc(EXIT_CMD);
}

/*********************************************************************************************
* 名称：get_currentMode()
* 功能：获取当前遥控模式
* 参数：无
* 返回：当前遥控模式
* 修改：
* 注释：
*********************************************************************************************/
uint8_t get_currentMode(void)
{
  return currentMode;
}

/*********************************************************************************************
* 名称：get_currentStatus()
* 功能：获取当前学习状态
* 参数：currentStatus-当前学习状态
* 返回：无
* 修改：
* 注释：
*********************************************************************************************/
uint8_t get_currentStatus(void)
{
  return currentStatus;
}

/*********************************************************************************************
* 名称：set_currentStatus()
* 功能：设置当前学习状态
* 参数：无
* 返回：当前学习状态
* 修改：
* 注释：
*********************************************************************************************/
void set_currentStatus(uint8_t status)
{
  currentStatus = status;
}

/*********************************************************************************************
* 名称：set_keyValue()
* 功能：设置当前键值
* 参数：value-当前键值
* 返回：无
* 修改：
* 注释：
*********************************************************************************************/
void set_keyValue(uint8_t value)
{
  keyValue = value;
}

/*********************************************************************************************
* 名称：send_keyValue()
* 功能：串口发送键值
* 参数：value-需要发送的键值
* 返回：无
* 修改：
* 注释：
*********************************************************************************************/
void send_keyValue(uint8_t value)
{
  uart2_putc(value);
}

uint8_t get_handleFlag(void)
{
  return handleFlag;
}

void set_handleFlag(uint8_t value)
{
  handleFlag = value;
}
/*********************************************************************************************
* 名称：uart2_rec_handle()
* 功能：串口2回调函数
* 参数：ch-串口接收的数据
* 返回：无
* 修改：
* 注释：
*********************************************************************************************/
int uart2_rec_handle(char ch)
{
  static uint8_t error = 0;
  if(ch == LEARN_CMD)
    currentMode = 1;
  if(ch == EXIT_CMD)
    currentMode = 0;
  if(ch == LEARN_SUCCESS_RET)
  {
    if(currentMode == 1)
    {
      set_currentMode(0x00);
      currentStatus = 1;
    }
  }
  if(ch == LEARN_ERROR_RET)                                     
  {
    if(currentMode == 1)                                        // 学习失败  再次进入学习这个键值    
    {
      error++;
      if(error <= 3)                                            // 学习失败不超过三次
        send_keyValue(keyValue);    
      else                                                      // 学习失败超过三次
      {
        set_currentMode(0x00);                                  // 退出学习模式
        error = 0;
      }
    }
  }
  handleFlag = 1;
  return 1;
}












